## conf/layer.conf
```bitbake
# We have a conf and classes directory, add to BBPATH
BBPATH .= ":${LAYERDIR}"

# We have recipes-* directories, add to BBFILES
BBFILES += "${LAYERDIR}/recipes-*/*/*.bb \
	${LAYERDIR}/recipes-*/*/*.bbappend"

BBFILE_COLLECTIONS += "meta-ivi-renesas"
BBFILE_PATTERN_meta-ivi-renesas = "^${LAYERDIR}/"
BBFILE_PRIORITY_meta-ivi-renesas = "6"
```
